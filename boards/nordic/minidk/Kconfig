## boards/nordic/minidk/Kconfig
```kconfig
if BOARD_MINIDK

config BOARD_ENABLE_DCDC
    bool "DCDC mode"
    select SOC_DCDC_NRF52X
    default y

# BT_CTLR depends on BT. When BT is enabled we should default to also
# enabling the controller.
config BT_CTLR
    default y if BT

endif # BOARD_MINIDK
```
